/dts-v1/;

/ {
	compatible = "allwinner,sun4i-a10";

	fragment@0 {
		target = <0xffffffff>;

		__overlay__ {

			w1_pins {
				pins = "PI15";
				function = "gpio_in";
				phandle = <0x01>;
			};
		};
	};

	fragment@1 {
		target-path = "/";

		__overlay__ {

			onewire@0 {
				compatible = "w1-gpio";
				pinctrl-names = "default";
				pinctrl-0 = <0x01>;
				gpios = <0xffffffff 0x08 0x0f 0x00>;
				status = "okay";
			};
		};
	};

	__symbols__ {
		w1_pins = "/fragment@0/__overlay__/w1_pins";
	};

	__fixups__ {
		pio = "/fragment@0:target:0\0/fragment@1/__overlay__/onewire@0:gpios:0";
	};

	__local_fixups__ {

		fragment@1 {

			__overlay__ {

				onewire@0 {
					pinctrl-0 = <0x00>;
				};
			};
		};
	};
};
